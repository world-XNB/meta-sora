## conf/layer.conf
```bitbake
# We have a conf and classes directory, add to BBPATH
BBPATH .= ":${LAYERDIR}"

# We have recipes-* directories, add to BBFILES
BBFILES += "${LAYERDIR}/recipes-*/*/*.bb \
            ${LAYERDIR}/recipes-*/*/*.bbappend"

BBFILE_COLLECTIONS += "meta-sora"
BBFILE_PATTERN_meta-sora = "^${LAYERDIR}/"
BBFILE_PRIORITY_meta-sora = "6"

LAYERDEPENDS_meta-sora = "core"
LAYERSERIES_COMPAT_meta-sora = "scarthgap"
```
